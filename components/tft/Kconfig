## components/tft/Kconfig
```kconfig
menu "TFT Display"

config TFT_INVERT_ROTATION1
    bool "Invert rotation1."
    default n
    help
    If text is backwards on your display, try enabling this.

config TFT_PIN_NUM_RST
    int "GPIO for Reset"
    default 0
    help
    If not using an EXAMPLE display type, configure the reset pin here.

config TFT_DISPLAY_WIDTH
    int "TFT display width in pixels."
    default 240
    help
    The smaller dimension (in portrait).

config TFT_DISPLAY_HEIGHT
    int "TFT display height in pixels."
    default 320
    help
    The smaller dimension (in portrait).

endmenu
```

## main/Kconfig.projbuild
```kconfig
menu "TFT Display DEMO Configuration"

config SPIFFS_BASE_ADDR
    hex "SPIFFS Base address"
    range 100000 1FFE000
    default 180000
    help
	Starting address of the SPIFFS area in ESP32 Flash

config SPIFFS_SIZE
    int "SPIFFS Size in bytes"
    range 262144 2097152
    default 1048576

config SPIFFS_LOG_BLOCK_SIZE
    int "SPIFFS Logical block size"
    range 4098 65536
    default 8192

config SPIFFS_LOG_PAGE_SIZE
    int "SPIFFS Logical page size"
    range 256 2048
    default 256
    help
	Set it to the phisycal page size og the used SPI Flash chip.

config EXAMPLE_USE_WIFI
    bool "Use wifi in TFT Demo"
    default n
    help
        If WiFi is used ntp server will be used to provide the exact time
        and file timestamps will be correct.
config WIFI_SSID
    string "WiFi SSID"
   	depends on EXAMPLE_USE_WIFI
    default "myssid"
    help
	SSID (network name) for the demo to connect to.

config WIFI_PASSWORD
    string "WiFi Password"
   	depends on EXAMPLE_USE_WIFI
    default "mypassword"
    help
	WiFi password (WPA or WPA2) for the demo to use.


endmenu
```
